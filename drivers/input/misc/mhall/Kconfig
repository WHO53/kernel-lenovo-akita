## drivers/input/misc/mhall/Kconfig
```kconfig
config CONFIG_INPUT_MHALL
	tristate "CONFIG_INPUT_MHALL"
	 

source "drivers/input/misc/mhall/bu52013hfv/Kconfig"
```

## drivers/membrane/Kconfig
```kconfig
# SPDX-License-Identifier: GPL-2.0-only

config DRM_MEMBRANE
        tristate "Membrane DRM Driver"
        depends on DRM
	    select DRM_KMS_HELPER
        help
          Membrane DRM Driver for libhybris devices to run
          applications using standard DRM APIs.
```
